/* Arduino Beats
by Sebastian Tomczak
6 April 2008
*/

// Working Variables
byte byteA;
byte byteB;
int delayTime = 100;
int barLength = 16;

// Beats
byte bar1[] = {1, 0, 1, 0, 2, 4, 1, 2, 1, 0, 1, 0, 2, 1, 3, 0};
byte bar2[] = {1, 0, 1, 0, 2, 0, 1, 2, 1, 0, 1, 0, 2, 2, 2, 2};
byte bar3[] = {1, 3, 1, 3, 2, 3, 1, 2, 1, 3, 1, 2, 1, 1, 4, 4};
byte bar4[] = {1, 0, 1, 0, 2, 2, 0, 2, 2, 1, 1, 4, 1, 1, 4, 4};

byte barLuis[] = {1, 0, 2, 0, 1, 0, 2, 0, 1, 0, 2, 0, 1, 1, 1, 1};

// Samples
byte kick[] = {127, 80, 42, 5, 165, 242, 241, 233, 128, 73, 48, 22, 127,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 126, 126};
byte snare[] = {127, 215, 65, 212, 56, 102, 135, 122, 51, 201, 220, 46, 175,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 126, 126};
byte hat[] = {127, 128, 225, 217, 99, 38, 61, 153, 152, 144, 133, 73, 122,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 127, 127};
byte crash[] = {127, 128, 225, 217, 99, 38, 61, 153, 152, 144, 133, 73,122,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 127, 127};

void setup() {
  DDRD = DDRD | B11111100;
}

void loop() {

  for(int j = 0; j < barLength; j ++) {  
    playBeat(barLuis[j]);
  }
  
  /*
  for(int j = 0; j < barLength; j ++) {  
    playBeat(bar1[j]);
  }

  for(int j = 0; j < barLength; j ++) {  
    playBeat(bar1[j]);  
  }
  
  for(int j = 0; j < barLength; j ++) {  
    playBeat(bar1[j]);
  }
  
  for(int j = 0; j < barLength; j ++) {  
    playBeat(bar2[j]);
  }

  for(int j = 0; j < barLength; j ++) {  
    playBeat(bar1[j]);
  }
  
  for(int j = 0; j < barLength; j ++) {  
    playBeat(bar1[j]);  
  }
  
  for(int j = 0; j < barLength; j ++) {
    playBeat(bar1[j]);
  }
  
  for(int j = 0; j < barLength; j ++) {  
    playBeat(bar3[j]);
  }

  for(int j = 0; j < barLength; j ++) {  
    playBeat(bar1[j]);  
  }
  
  for(int j = 0; j < barLength; j ++) {  
    playBeat(bar1[j]);  
  }
  
  for(int j = 0; j < barLength; j ++) {  
    playBeat(bar1[j]);  
  }
  
  for(int j = 0; j < barLength; j ++) {  
    playBeat(bar2[j]);  
  }
  
  for(int j = 0; j < barLength; j ++) {  
    playBeat(bar1[j]);  
  }

  for(int j = 0; j < barLength; j ++) {
    playBeat(bar1[j]);
  }

  for(int j = 0; j < barLength; j ++) {
    playBeat(bar1[j]);
  }

  for(int j = 0; j < barLength; j ++) {
     playBeat(bar4[j]);
  }*/
}


// Playback Functions
void playBeat(byte beat) {
  if(beat == 0) {
    for(int i = 0; i < 256; i ++) {
      delayMicroseconds(analogRead(0) + 1);
    }
  }
  else if(beat == 1) {
    playKick();
  }
  else if(beat == 2) {
    playSnare();
  }
  else if(beat == 3) {
    playHat();
  }
  else if(beat == 4) {
    playCrash();
  }
  delay(delayTime);
}

void playKick() {
  for(int i = 0; i < 256; i ++) {
    PORTD = kick[i];
    delayMicroseconds(analogRead(0) + 1);
  }
  PORTD = 127;
}

void playSnare() {
  for(int i = 0; i < 256; i ++) {
    PORTD = snare[i];
    delayMicroseconds(analogRead(0) + 1);
  }
  PORTD = 127;
}

void playHat() {
  for(int i = 0; i < 256; i ++) {
    PORTD = hat[i];
    delayMicroseconds(analogRead(0) + 1);
  }
  PORTD = 127;
}

void playCrash() {
  for(int i = 0; i < 256; i ++) {
    PORTD = crash[i];
    delayMicroseconds(analogRead(0) + 1);
  }
  PORTD = 127;
}
